## sources/meta-planer/conf/distro/imx93-planer.conf
```bitbake
# Base NXP distro
require conf/distro/fsl-imx-xwayland.conf

DISTRO = "imx93-planer"
DISTRO_NAME = "i.MX03 Planner"
DISTRO_VERSION = "1.0"

# --------------------------------------------------
# Init system
# --------------------------------------------------
DISTRO_FEATURES:append = " systemd usrmerge"
DISTRO_FEATURES:remove = " sysvinit"
DISTRO_FEATURES_BACKFILL_CONSIDERED:append = " sysvinit"

VIRTUAL-RUNTIME_init_manager = "systemd"
VIRTUAL-RUNTIME_initscripts = ""
PACKAGECONFIG:append:pn-systemd = " coredump"

#--------------------------------------------------
# ROS2 Humble
# --------------------------------------------------
ROS_OE_RELEASE_SERIES = "scarthgap"
ROS_DISTRO = "humble"

# --------------------------------
# Image trimming (optional)
# --------------------------------
DISTRO_FEATURES:remove = " x11"

# --------------------------------
# Kernel / module behavior
# --------------------------------
KERNEL_DEVICETREE += " \
    freescale/imx93-frdm-planer.dtb \
"

KERNEL_MODULE_AUTOLOAD:append = " \
    mlan \
    moal \
"

# --------------------------------
# Mender integration
# --------------------------------
require conf/mender-setup.inc
```
