## sources/meta-planer/conf/machine/imx93-planer.conf
```bitbake
MACHINEOVERRIDES =. "imx93-11x11-lpddr4x-frdm:"
require conf/machine/imx93-11x11-lpddr4x-frdm.conf

# Include device trees for other boards for internal test
KERNEL_DEVICETREE += " \
    freescale/imx93-frdm-planer.dtb \
"
```
